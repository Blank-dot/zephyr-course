## CMakeLists.txt
```
cmake_minimum_required(VERSION 3.20.0)

list(APPEND BOARD_ROOT ${CMAKE_CURRENT_SOURCE_DIR}/../)
find_package(Zephyr REQUIRED)
project(my_zephyr_app)

target_sources(app PRIVATE src/main.cpp)
add_subdirectory(../drivers/custom_driver custom_driver)
```

## Kconfig
```
menuconfig LED_SUBSYSTEM
	bool "LED Subsystem"
	default y
	choice
		prompt "Led blink sleep time"
		default BLINK_SLEEP_TIME_1000MS
		depends on LED_SUBSYSTEM
		config BLINK_SLEEP_TIME_250MS
			bool "Very Fast (250ms)"
		config BLINK_SLEEP_TIME_500MS
			bool "Fast (500ms)"
		config BLINK_SLEEP_TIME_1000MS
			bool "Medium (1s)"
		config BLINK_SLEEP_TIME_2000MS
			bool "Slow (2s)"
	endchoice
	config BLINK_SLEEP_TIME_MS
		int
		default 250 if BLINK_SLEEP_TIME_250MS
		default 500 if BLINK_SLEEP_TIME_500MS
		default 1000 if BLINK_SLEEP_TIME_1000MS
		default 2000 if BLINK_SLEEP_TIME_2000MS
		default 0
		depends on LED_SUBSYSTEM
	menuconfig ADV_LED_SETTINGS
		bool "Advanced LED settings"
		default n
		depends on LED_SUBSYSTEM
		config LED_BRIGHTNESS
			int "LED brightness (0-100)"
			default 100
			range 0 100
			depends on ADV_LED_SETTINGS
		config LED_FADE_DURATION
			int "LED fade duration (ms)"
			default 500
			range 0 5000
			depends on ADV_LED_SETTINGS
		menu "Expert settings"
			visible if ADV_LED_SETTINGS
			depends on ADV_LED_SETTINGS
			config LED_DEBUG
				bool "Enable LED debugging"
				default n
			config CUSTOM_BLINK_PATTERN
				bool "Custom blink pattern"
				default n
		endmenu

config APP_HEARTBEAT_PERIOD_MS
	int "Application Heartbeat period (ms)"
	default 500
	range 100 2000
source "Kconfig.zephyr"
rsource "../drivers/custom_driver/Kconfig"
```

## prj.conf
```kconfig
CONFIG_GPIO=y
CONFIG_LOG=y
CONFIG_SHELL=y
CONFIG_SHELL_CMDS=y
CONFIG_SHELL_TAB=y
CONFIG_SHELL_TAB_AUTOCOMPLETION=y
CONFIG_SHELL_HISTORY=y
CONFIG_SHELL_LOG_BACKEND=y
CONFIG_SHELL_BACKEND_SERIAL=y
```

## app.overlay
```dts
/ {
    aliases {
	app-led = &green_led_2;
    };
    
    custom_driver0: custom_driver {
        compatible = "custom,driver";
        gpio = <&green_led_2>;
        status = "okay";
    };
};
```

## dts/bindings/our,custom_driver.yml
```yaml
description: our custom driver
compatible: "our,custom_driver"
include: base.yaml
```

## src/main.cpp
```c
#include <zephyr/drivers/gpio.h>
#include <zephyr/kernel.h>
#include <zephyr/logging/log.h>
#include <zephyr/drivers/sensor.h>
#include <custom_driver.h>

LOG_MODULE_REGISTER(main, LOG_LEVEL_INF);

int main(void)
{
    const struct device* dev = DEVICE_DT_GET_ANY(custom_driver);
    struct sensor_value value;
    int led_state;
    if ( !device_is_ready(dev) )
    {
        return -ENODEV;
    }

    while (1) {
        led_state = custom_driver_extra( dev );
        if ( led_state )
        {
            sensor_channel_get( dev, SENSOR_CHAN_ALL, &value );
        }
        else
        {
            sensor_sample_fetch( dev );
        }
        LOG_INF("LED state: %s", led_state ? "ON" : "OFF");
        k_msleep(CONFIG_APP_HEARTBEAT_PERIOD_MS);
    }
    return 0;
}
```
