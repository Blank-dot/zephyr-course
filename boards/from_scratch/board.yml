## boards/from_scratch/board.yml
```yaml
board:
  name: from_scratch
  full_name: Nucleo F446RE COPY
  vendor: st
  socs:
    - name: stm32f446xx
```

## boards/nucleo_f446re_copy/Kconfig.nucleo_f446re_copy
```kconfig
# Copyright (c) 2018 Philémon Jaermann
# SPDX-License-Identifier: Apache-2.0

config BOARD_NUCLEO_F446RE_COPY
	select SOC_STM32F446XX
```

## boards/nucleo_f446re_copy/board.yml
```yaml
board:
  name: nucleo_f446re_copy
  full_name: Nucleo F446RE COPY
  vendor: st
  socs:
    - name: stm32f446xx
```
